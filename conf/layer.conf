## conf/machine/include/am62l-stamp-256mb.inc
```bitbake
require conf/machine/include/k3.inc
SOC_FAMILY:append = ":am62lxx"

MACHINE_FEATURES += "screen"

TFA_BOARD = "am62l-stamp-256mb"
TFA_K3_SYSTEM_SUSPEND = "1"

OPTEEMACHINE = "k3-am62lx"
```
